## meta-halium/conf/layer.conf
```bitbake
# We have a conf and classes directory, append to BBPATH
BBPATH .= ":${LAYERDIR}"

# We have a recipes directory, add to BBFILES
BBFILES += "${LAYERDIR}/recipes*/*/*.bb ${LAYERDIR}/recipes*/*/*.bbappend"

BBFILE_COLLECTIONS += "halium-layer"
BBFILE_PATTERN_halium-layer := "^${LAYERDIR}/"
BBFILE_PRIORITY_halium-layer = "7"

LAYERDEPENDS_halium-layer = "core openembedded-layer android-layer"

LAYERSERIES_COMPAT_halium-layer = "kirkstone"
```

## meta-halium/conf/machine/halium9-gsi.conf
```bitbake
#-----------------------------------------------------------------------------
#@TYPE: Machine
#@NAME: Halium 9 GSI (codename halium9-gsi)
#@DESCRIPTION: Machine configuration for Halium 9 GSI
#-----------------------------------------------------------------------------

require conf/machine/include/arm/arch-arm64.inc
require conf/machine/include/meta-android-halium.inc

#FIXME How to deal with kernel
#PREFERRED_PROVIDER_virtual/kernel ?= "linux-xiaomi-mido"
#MACHINE_KERNEL_PR = "r0"

MACHINE_FEATURES = "apm alsa bluetooth gps usbgadget usbhost phone wifi vfat ext2 keyboard nfc"
MACHINE_DISPLAY_WIDTH_PIXELS = "1080"
MACHINE_DISPLAY_HEIGHT_PIXELS = "1920"
MACHINE_DISPLAY_ORIENTATION = "0"
MACHINE_DISPLAY_PPI = "403"

PREFERRED_VERSION_android-headers-halium = "9.0%"
VIRTUAL-RUNTIME_android-system-image = "android-system-image-halium9-gsi"

#FIXME: We might need to move this elsewhere?
#ANDROID_HEADERS_DEFINES = "QCOM_BSP QTI_BSP QCOM_HARDWARE"

PREFERRED_PROVIDER_virtual/xserver = "xserver-xorg"
XSERVER = " \
    xserver-xorg \
    xf86-input-evdev \
    xf86-video-fbdev \
"

# We need fsck.vfat for vfat partitions we need to mount
# Also, include the wlan module for the kernel
#    android-kernel-bootimg 
#    kernel-module-wlan 

MACHINE_EXTRA_RDEPENDS = " \
    dosfstools \
"

KERNEL_IMAGETYPE = "Image.gz-dtb"
IMAGE_FSTYPES += "tar.gz"
IMAGE_ROOTFS_EXTRA_SPACE = "200000"

#FIXME we might need to move this elsewhere?
ANDROID_BOARD_BOOTIMAGE_PARTITION = "/dev/block/mmcblk0p21"
ANDROID_BOARD_SYSTEMIMAGE_PARTITION_SIZE = "3221225472"
ANDROID_BOARD_FLASH_BLOCK_SIZE = "131072"

SERIAL_CONSOLE = "115200 ttyHSL0"
```

## meta-oneplus/conf/machine/bacon.conf
```bitbake
#-----------------------------------------------------------------------------
#@TYPE: Machine
#@NAME: OnePlus One (codename bacon)
#@DESCRIPTION: Machine configuration for the OnePlus One
#-----------------------------------------------------------------------------

require conf/machine/include/tune-cortexa8.inc

TARGET_ARCH = "arm"

PREFERRED_PROVIDER_virtual/kernel ?= "linux-oneplus-bacon"
MACHINE_KERNEL_PR = "r0"

MACHINE_FEATURES = "apm alsa bluetooth gps usbgadget usbhost phone wifi vfat ext2 keyboard nfc"
MACHINE_DISPLAY_WIDTH_PIXELS = "1080"
MACHINE_DISPLAY_HEIGHT_PIXELS = "1920"
MACHINE_DISPLAY_ORIENTATION = "0"
MACHINE_DISPLAY_PPI = "401"

PREFERRED_PROVIDER_virtual/libgl ?= "mesa-gl"
PREFERRED_PROVIDER_virtual/libgbm ?= "mesa-gl"
PREFERRED_PROVIDER_virtual/egl ?= "libhybris"
PREFERRED_PROVIDER_virtual/mesa ?= "libhybris"
PREFERRED_PROVIDER_virtual/libgles1 ?= "libhybris"
PREFERRED_PROVIDER_virtual/libgles2 ?= "libhybris"

PREFERRED_PROVIDER_virtual/android-headers = "android-headers-halium"
PREFERRED_VERSION_android-headers-halium = "7.1+git%"
VIRTUAL-RUNTIME_android-system-image = "android-system-image-bacon"
ANDROID_HEADERS_DEFINES = "QCOM_BSP QTI_BSP QCOM_HARDWARE"

PREFERRED_PROVIDER_virtual/xserver = "xserver-xorg"
XSERVER = " \
    xserver-xorg \
    xf86-input-evdev \
    xf86-video-fbdev \
"

# We need fsck.vfat for vfat partitions we need to mount
# Also, include the wlan module for the kernel
MACHINE_EXTRA_RDEPENDS = " \
    android-kernel-bootimg \
    dosfstools \
"

KERNEL_IMAGETYPE = "zImage-dtb"
IMAGE_FSTYPES += "tar.gz ext4"
IMAGE_ROOTFS_EXTRA_SPACE = "200000"

ANDROID_BOOTIMG_CMDLINE = "console=ttyHSL0,115200,n8 androidboot.hardware=bacon user_debug=31 msm_rtb.filter=0x3F ehci-hcd.park=3 androidboot.bootdevice=msm_sdcc.1"
ANDROID_BOOTIMG_KERNEL_RAM_BASE = "0x00008000" 
ANDROID_BOOTIMG_RAMDISK_RAM_BASE = "0x02000000"
ANDROID_BOOTIMG_SECOND_RAM_BASE = "0x00f00000" 
ANDROID_BOOTIMG_TAGS_RAM_BASE = "0x01e00000"
ANDROID_EXTRA_INITRAMFS_IMAGE_INSTALL = "udev e2fsprogs-e2fsck e2fsprogs-resize2fs"

ANDROID_BOARD_BOOTIMAGE_PARTITION = "/dev/block/mmcblk0p7"
ANDROID_BOARD_SYSTEMIMAGE_PARTITION_SIZE = "1388314624"
ANDROID_BOARD_FLASH_BLOCK_SIZE = "131072"

SERIAL_CONSOLE = "115200 ttyHSL0"
```

## meta-oneplus/conf/machine/dumpling.conf
```bitbake
#-----------------------------------------------------------------------------
#@TYPE: Machine
#@NAME: OnePlus 5T (codename dumpling)
#@DESCRIPTION: Machine configuration for the OnePlus 5T
#-----------------------------------------------------------------------------

require conf/machine/include/arm/arch-arm64.inc

PREFERRED_PROVIDER_virtual/kernel ?= "linux-oneplus-dumpling"
MACHINE_KERNEL_PR = "r0"

MACHINE_FEATURES = "apm alsa bluetooth gps usbgadget usbhost phone wifi vfat ext2 keyboard nfc"
MACHINE_DISPLAY_WIDTH_PIXELS = "1080"
MACHINE_DISPLAY_HEIGHT_PIXELS = "2160"
MACHINE_DISPLAY_ORIENTATION = "0"
MACHINE_DISPLAY_PPI = "401"

PREFERRED_PROVIDER_virtual/libgl ?= "mesa-gl"
PREFERRED_PROVIDER_virtual/libgbm ?= "mesa-gl"
PREFERRED_PROVIDER_virtual/egl ?= "libhybris"
PREFERRED_PROVIDER_virtual/mesa ?= "libhybris"
PREFERRED_PROVIDER_virtual/libgles1 ?= "libhybris"
PREFERRED_PROVIDER_virtual/libgles2 ?= "libhybris"

PREFERRED_PROVIDER_virtual/android-headers = "android-headers-halium"
PREFERRED_VERSION_android-headers-halium = "7.1+git%"
VIRTUAL-RUNTIME_android-system-image = "android-system-image-dumpling"
ANDROID_HEADERS_DEFINES = "QCOM_BSP QTI_BSP QCOM_HARDWARE"

PREFERRED_PROVIDER_virtual/xserver = "xserver-xorg"
XSERVER = " \
    xserver-xorg \
    xf86-input-evdev \
    xf86-video-fbdev \
"

# We need fsck.vfat for vfat partitions we need to mount
# Also, include the wlan module for the kernel
MACHINE_EXTRA_RDEPENDS = " \
    android-kernel-bootimg \
    dosfstools \
"

KERNEL_IMAGETYPE = "Image.gz-dtb"
IMAGE_FSTYPES += "tar.gz ext4"
IMAGE_ROOTFS_EXTRA_SPACE = "200000"

ANDROID_BOOTIMG_CMDLINE = "androidboot.hardware=qcom ehci-hcd.park=3 lpm_levels.sleep_disabled=1 sched_enable_hmp=1 sched_enable_power_aware=1 service_locator.enable=1 swiotlb=2048"
ANDROID_BOOTIMG_KERNEL_RAM_BASE = "0x00008000" 
ANDROID_BOOTIMG_RAMDISK_RAM_BASE = "0x02000000"
ANDROID_BOOTIMG_SECOND_RAM_BASE = "0x00f00000" 
ANDROID_BOOTIMG_TAGS_RAM_BASE = "0x01e00000"
ANDROID_EXTRA_INITRAMFS_IMAGE_INSTALL = "udev e2fsprogs-e2fsck e2fsprogs-resize2fs"

ANDROID_BOARD_BOOTIMAGE_PARTITION = "/dev/block/mmcblk0p7"
ANDROID_BOARD_SYSTEMIMAGE_PARTITION_SIZE = "3221225472"
ANDROID_BOARD_FLASH_BLOCK_SIZE = "131072"

SERIAL_CONSOLE = "115200 ttyHSL0"
```

## meta-razer/conf/layer.conf
```bitbake
# We have a conf and classes directory, append to BBPATH
BBPATH .= ":${LAYERDIR}"

# We have a recipes directory, add to BBFILES
BBFILES += "${LAYERDIR}/recipes*/*/*.bb ${LAYERDIR}/recipes*/*/*.bbappend"

BBFILE_COLLECTIONS += "razer-layer"
BBFILE_PATTERN_razer-layer := "^${LAYERDIR}/"
BBFILE_PRIORITY_razer-layer = "7"

LAYERDEPENDS_razer-layer = "core openembedded-layer android-layer"

LAYERSERIES_COMPAT_razer-layer = "gatesgarth"
```

## meta-razer/conf/machine/cheryl.conf
```bitbake
#-----------------------------------------------------------------------------
#@TYPE: Machine
#@NAME: Razer Phone 1 (codename cheryl)
#@DESCRIPTION: Machine configuration for the Razer Phone 1
#-----------------------------------------------------------------------------

require conf/machine/include/arm/arch-arm64.inc
require conf/machine/include/meta-android-halium.inc

PREFERRED_PROVIDER_virtual/kernel ?= "linux-razer-cheryl"
MACHINE_KERNEL_PR = "r0"

MACHINE_FEATURES = "apm alsa bluetooth gps usbgadget usbhost phone wifi vfat ext2 keyboard nfc"
MACHINE_DISPLAY_WIDTH_PIXELS = "1440"
MACHINE_DISPLAY_HEIGHT_PIXELS = "2560"
MACHINE_DISPLAY_ORIENTATION = "0"
MACHINE_DISPLAY_PPI = "515"

PREFERRED_VERSION_android-headers-halium = "9.0%"
VIRTUAL-RUNTIME_android-system-image = "android-system-image-cheryl"
ANDROID_HEADERS_DEFINES = "QCOM_BSP QTI_BSP QCOM_HARDWARE"

PREFERRED_PROVIDER_virtual/xserver = "xserver-xorg"
XSERVER = " \
    xserver-xorg \
    xf86-input-evdev \
    xf86-video-fbdev \
"

# We need fsck.vfat for vfat partitions we need to mount
# Also, include the wlan module for the kernel
MACHINE_EXTRA_RDEPENDS = " \
    android-kernel-bootimg \
    dosfstools \
"

#    kernel-module-wlan \

KERNEL_IMAGETYPE = "Image.gz-dtb"
IMAGE_FSTYPES += "tar.gz"
IMAGE_ROOTFS_EXTRA_SPACE = "200000"

ANDROID_BOARD_BOOTIMAGE_PARTITION = "/dev/block/sde11"
ANDROID_BOARD_SYSTEMIMAGE_PARTITION_SIZE = "3758096384"
ANDROID_BOARD_FLASH_BLOCK_SIZE = "131072"

SERIAL_CONSOLE = "115200 ttyHSL0"
```
